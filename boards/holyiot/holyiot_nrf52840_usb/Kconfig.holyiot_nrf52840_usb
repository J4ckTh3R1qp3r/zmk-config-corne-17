## boards/holyiot/holyiot_nrf52840_usb/Kconfig.holyiot_nrf52840_usb
```kconfig
config BOARD_HOLYIOT_NRF52840_USB
    select SOC_NRF52840_QIAA
    select ZMK_BOARD_COMPAT
    imply RETAINED_MEM
    imply RETENTION
    imply RETENTION_BOOT_MODE
```

## boards/holyiot/holyiot_nrf52840_usb/board.yml
```yaml
board:
  name: holyiot_nrf52840_usb
  full_name: HOLYIOT nRF52840 USB (MDK UF2)
  vendor: holyiot
  socs:
    - name: nrf52840
```

## boards/holyiot/holyiot_nrf52840_usb/holyiot_nrf52840_usb_defconfig
```kconfig
CONFIG_ARM_MPU=y
CONFIG_HW_STACK_PROTECTION=y
CONFIG_GPIO=y
CONFIG_ADC=y

CONFIG_USE_DT_CODE_PARTITION=y
CONFIG_BUILD_OUTPUT_UF2=y

CONFIG_MPU_ALLOW_FLASH_WRITE=y
CONFIG_NVS=y
CONFIG_SETTINGS_NVS=y
CONFIG_FLASH=y
CONFIG_FLASH_PAGE_LAYOUT=y
CONFIG_FLASH_MAP=y

CONFIG_ZMK_USB=y
CONFIG_ZMK_BLE=y
CONFIG_RETAINED_MEM=y
CONFIG_RETENTION=y
CONFIG_RETENTION_BOOT_MODE=y
CONFIG_ZMK_BOOTMODE_MAGIC_VALUE_BOOTLOADER_TYPE_ADAFRUIT_NRF52=y
```
